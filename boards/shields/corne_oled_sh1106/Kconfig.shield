## boards/shields/corne_oled_sh1106/Kconfig.shield
```kconfig
# Copyright (c) 2026 Osvaldo Cordova Aburto
# SPDX-License-Identifier: MIT

config SHIELD_CORNE_OLED_SH1106
    def_bool $(shields_list_contains,corne_oled_sh1106)
```
